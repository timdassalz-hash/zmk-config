## config/boards/shields/mymouse/Kconfig.defconfig
```kconfig
if SHIELD_MYMOUSE
config ZMK_KEYBOARD_NAME
    default "mymouse"
config ZMK_SPLIT
    default y
config BT_MAX_CONN
    default 2
config BT_MAX_PAIRED
    default 2
endif
```

## config/boards/shields/mymouse/Kconfig.shield
```kconfig
config SHIELD_MYMOUSE
    def_bool $(shields_list_contains,mymouse)
    select ZMK_KSCAN_DIRECT_GPIO
    select SPI
```

## config/boards/shields/mymouse_dongle/Kconfig.defconfig
```kconfig
if SHIELD_MYMOUSE_DONGLE
config ZMK_KEYBOARD_NAME
    default "mymouse"
config ZMK_SPLIT_ROLE_CENTRAL
    default y
config ZMK_SPLIT
    default y
config ZMK_SPLIT_BLE_CENTRAL_PERIPHERALS
    default 1
config BT_MAX_CONN
    default 2
config BT_MAX_PAIRED
    default 2
endif
```

## config/boards/shields/mymouse_dongle/Kconfig.shield
```kconfig
config SHIELD_MYMOUSE_DONGLE
    def_bool $(shields_list_contains,mymouse_dongle)
```

## config/west.yml
```yaml
manifest:
  remotes:
    - name: zmkfirmware
      url-base: https://github.com/zmkfirmware
    - name: nickcoutsos
      url-base: https://github.com/nickcoutsos
    - name: badjeff
      url-base: https://github.com/badjeff
  projects:
    - name: zmk
      remote: zmkfirmware
      revision: main
      import: app/west.yml
    - name: zmk-nice-nano
      remote: nickcoutsos
      revision: master
    - name: zmk-paw3395-driver
      remote: badjeff
      revision: main
  self:
    path: config
```
